## esp32/main/Kconfig.projbuild
```kconfig
menu "Minihub Configuration"

    config GATEWAY_UDP_PROVISIONING
        bool
        default y
        select ESP_WIFI_SOFTAP_SUPPORT

    config GATEWAY_SETUP_PASSWORD
        string "Wi-Fi setup AP password (8-63 characters)"
        default "configureme"
        help
            WPA2 requires 8-63 bytes. An invalid value uses configureme at runtime.

    config ENABLE_LITTLEFS
        bool "Enable use Little FS"
        default y
        help
            Enable use Little FS

endmenu
```

## esp32/sdkconfig.defaults
```kconfig
CONFIG_PARTITION_TABLE_CUSTOM=y
CONFIG_PARTITION_TABLE_CUSTOM_FILENAME="partitions.csv"
CONFIG_ESPTOOLPY_FLASHSIZE_4MB=y
CONFIG_BOOTLOADER_APP_ROLLBACK_ENABLE=y
CONFIG_MBEDTLS_CERTIFICATE_BUNDLE=y
CONFIG_MBEDTLS_CERTIFICATE_BUNDLE_DEFAULT_FULL=y
CONFIG_ESP_MAIN_TASK_STACK_SIZE=8192
CONFIG_FREERTOS_HZ=1000

CONFIG_COMPILER_OPTIMIZATION_SIZE=y
CONFIG_COMPILER_OPTIMIZATION_ASSERTIONS_SILENT=y
# CONFIG_LWIP_IPV6 is not set
# CONFIG_ESP_WIFI_ENTERPRISE_SUPPORT is not set
# CONFIG_ESP_WIFI_SOFTAP_SUPPORT is not set
CONFIG_MBEDTLS_TLS_CLIENT_ONLY=y
# CONFIG_MBEDTLS_ECP_DP_SECP192R1_ENABLED is not set
# CONFIG_MBEDTLS_ECP_DP_SECP224R1_ENABLED is not set
# CONFIG_MBEDTLS_ECP_DP_SECP192K1_ENABLED is not set
# CONFIG_MBEDTLS_ECP_DP_SECP224K1_ENABLED is not set
# CONFIG_MBEDTLS_ECP_DP_SECP256K1_ENABLED is not set
# CONFIG_MBEDTLS_ECP_DP_BP256R1_ENABLED is not set
# CONFIG_MBEDTLS_ECP_DP_BP384R1_ENABLED is not set
# CONFIG_MBEDTLS_ECP_DP_BP512R1_ENABLED is not set
```

## esp32c3-node/main/Kconfig.projbuild
```kconfig
menu "RS485 sensor node"
choice NODE_SENSOR
    prompt "Node sensor"
    default NODE_SENSOR_ZS03
config NODE_SENSOR_ZE03
    bool "ZE03 H2S / NH3 (UART)"
config NODE_SENSOR_WPCH01
    bool "WPCH01 water pressure (I2C, protocol required)"
config NODE_SENSOR_ZS03
    bool "ZS03 temperature / humidity (single wire)"
endchoice
config NODE_SENSOR_TYPE
    int
    default 1 if NODE_SENSOR_ZE03
    default 4 if NODE_SENSOR_WPCH01
    default 2
config NODE_ZE03_H2S_RX
    int "ZE03 H2S TXD -> node RX GPIO (UART0)"
    range 0 21
    default 20
    depends on NODE_SENSOR_ZE03
config NODE_ZE03_H2S_TX
    int "Node TX GPIO -> ZE03 H2S RXD (UART0)"
    range 0 21
    default 21
    depends on NODE_SENSOR_ZE03
config NODE_ZE03_NH3_RX
    int "ZE03 NH3 TXD -> node RX GPIO (UART1)"
    range 0 21
    default 4
    depends on NODE_SENSOR_ZE03
config NODE_ZE03_NH3_TX
    int "Node TX GPIO -> ZE03 NH3 RXD (UART1)"
    range 0 21
    default 5
    depends on NODE_SENSOR_ZE03
config NODE_RS485_SOFT
    bool
    default y if NODE_SENSOR_ZE03
    default n
    help
        ZE03 uses both hardware UARTs. RS485 receives timestamped GPIO edges
        and transmits 8N1 using RMT, keeping RX=6/TX=7 and the existing protocol.
config NODE_ZS03_GPIO
    int "ZS03 DATA GPIO"
    range 0 21
    default 4
    depends on NODE_SENSOR_ZS03
config NODE_I2C_SDA
    int "WPCH01 SDA GPIO"
    range 0 21
    default 4
    depends on NODE_SENSOR_WPCH01
config NODE_I2C_SCL
    int "WPCH01 SCL GPIO"
    range 0 21
    default 5
    depends on NODE_SENSOR_WPCH01
config NODE_UART_TX
    int "RS485 TX GPIO"
    range 0 21
    default 7
config NODE_UART_RX
    int "RS485 RX GPIO"
    range 0 21
    default 6
config NODE_UART_DE
    int "RS485 DE + /RE GPIO"
    range 0 21
    default 10
config NODE_RESET_GPIO
    int "Active-low factory reset button GPIO"
    range 0 21
    default 3
endmenu
```

## esp32c3-node/sdkconfig.defaults
```kconfig
CONFIG_IDF_TARGET="esp32c3"
CONFIG_ESPTOOLPY_FLASHSIZE_4MB=y
CONFIG_PARTITION_TABLE_CUSTOM=y
CONFIG_PARTITION_TABLE_CUSTOM_FILENAME="partitions.csv"
CONFIG_ESP_CONSOLE_UART_DEFAULT=y
CONFIG_ESP_CONSOLE_SECONDARY_USB_SERIAL_JTAG=y
CONFIG_FREERTOS_HZ=1000
```
